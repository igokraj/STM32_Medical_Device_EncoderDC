// **** MINIMAL SSD1306 128x64 I2C DRIVER ****
#include "ssd1306.h"
#include "i2c.h"
#include <string.h>

static uint8_t buffer[SSD1306_WIDTH * SSD1306_HEIGHT / 8];
static uint8_t cursor_x = 0;
static uint8_t cursor_y = 0;

// 5x7 font, ASCII 0x20-0x7E, one column of padding added when drawn
static const uint8_t font5x7[95][5] = {
  {0x00,0x00,0x00,0x00,0x00}, // ' '
  {0x00,0x00,0x5F,0x00,0x00}, // !
  {0x00,0x07,0x00,0x07,0x00}, // "
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  {0x08,0x08,0x2A,0x1C,0x08}, // ~
};

static void SSD1306_WriteCommand(uint8_t cmd)
{
  uint8_t data[2] = {0x00, cmd};
  HAL_I2C_Master_Transmit(&hi2c1, SSD1306_I2C_ADDR, data, 2, 100);
}

void SSD1306_Init(void)
{
  HAL_Delay(100);
  SSD1306_WriteCommand(0xAE); // display off
  SSD1306_WriteCommand(0x20); SSD1306_WriteCommand(0x00); // horizontal addressing mode
  SSD1306_WriteCommand(0xB0);
  SSD1306_WriteCommand(0xC8); // COM scan direction
  SSD1306_WriteCommand(0x00);
  SSD1306_WriteCommand(0x10);
  SSD1306_WriteCommand(0x40);
  SSD1306_WriteCommand(0x81); SSD1306_WriteCommand(0x7F); // contrast
  SSD1306_WriteCommand(0xA1); // segment remap
  SSD1306_WriteCommand(0xA6); // normal (not inverted)
  SSD1306_WriteCommand(0xA8); SSD1306_WriteCommand(0x3F); // multiplex 64
  SSD1306_WriteCommand(0xA4);
  SSD1306_WriteCommand(0xD3); SSD1306_WriteCommand(0x00);
  SSD1306_WriteCommand(0xD5); SSD1306_WriteCommand(0xF0);
  SSD1306_WriteCommand(0xD9); SSD1306_WriteCommand(0x22);
  SSD1306_WriteCommand(0xDA); SSD1306_WriteCommand(0x12);
  SSD1306_WriteCommand(0xDB); SSD1306_WriteCommand(0x20);
  SSD1306_WriteCommand(0x8D); SSD1306_WriteCommand(0x14); // charge pump on
  SSD1306_WriteCommand(0xAF); // display on

  SSD1306_Clear();
  SSD1306_UpdateScreen();
}

void SSD1306_Clear(void)
{
  memset(buffer, 0x00, sizeof(buffer));
  cursor_x = 0;
  cursor_y = 0;
}

void SSD1306_SetCursor(uint8_t x, uint8_t y)
{
  cursor_x = x;
  cursor_y = y;
}

void SSD1306_WriteChar(char c)
{
  if (c < 0x20 || c > 0x7E) {
    c = ' ';
  }

  if (cursor_x + 6 > SSD1306_WIDTH) {
    cursor_x = 0;
    cursor_y++;
  }
  if (cursor_y > 7) {
    return;   // out of screen, ignore
  }

  const uint8_t *glyph = font5x7[c - 0x20];
  uint16_t byteIndex = (uint16_t)cursor_y * SSD1306_WIDTH + cursor_x;

  for (uint8_t col = 0; col < 5; col++) {
    buffer[byteIndex + col] = glyph[col];
  }
  buffer[byteIndex + 5] = 0x00;   // 1px space between characters

  cursor_x += 6;
}

void SSD1306_WriteString(const char *str)
{
  while (*str) {
    SSD1306_WriteChar(*str);
    str++;
  }
}

void SSD1306_DrawProgressBar(uint8_t page, uint8_t percent)
{
  if (page > 7) {
    return;
  }
  if (percent > 100) {
    percent = 100;
  }

  uint16_t filledWidth = ((uint16_t)SSD1306_WIDTH * percent) / 100;

  for (uint16_t x = 0; x < SSD1306_WIDTH; x++) {
    // filled = solid column, empty = outline only (top+bottom pixel)
    buffer[(uint16_t)page * SSD1306_WIDTH + x] = (x < filledWidth) ? 0xFF : 0x81;
  }
}

void SSD1306_UpdateScreen(void)
{
  for (uint8_t page = 0; page < 8; page++) {
    SSD1306_WriteCommand(0xB0 + page);
    SSD1306_WriteCommand(0x00);
    SSD1306_WriteCommand(0x10);

    uint8_t data[SSD1306_WIDTH + 1];
    data[0] = 0x40;
    memcpy(&data[1], &buffer[page * SSD1306_WIDTH], SSD1306_WIDTH);
    HAL_I2C_Master_Transmit(&hi2c1, SSD1306_I2C_ADDR, data, SSD1306_WIDTH + 1, 100);
  }
}
